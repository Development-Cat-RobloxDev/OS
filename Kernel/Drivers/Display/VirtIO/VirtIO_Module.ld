OUTPUT_FORMAT(elf64-x86-64)
ENTRY(driver_module_init)

SECTIONS
{
    . = 0x00800000;

    .text ALIGN(4K) : {
        *(.text*)
    }

    .rodata ALIGN(4K) : {
        *(.rodata*)
    }

    .data ALIGN(4K) : {
        *(.data*)
    }

    .bss ALIGN(4K) : {
        *(COMMON)
        *(.bss*)
    }
}
